BU_: EVO_CHARGER_2 W_PUMP_BAT EVO_CHARGER_1 VCU PDU DIAGNOSTIC BSC6 BOOT_PDU_PC_APP BOOT_PDU W_PUMP_MOT PLC IVI_M2M TCK FBO6 LOGGER Airbag EBKV Gateway_MQB _4INtck_T_Motors _4INtck_T_Inverters
VAL_TABLE_ IVI_MEASURING_SYSTEM 1 "imperial" 0 "metric" ;
VAL_TABLE_ RND_VALUES 2 "DRIVE" 1 "REVERSE" 0 "NEUTRAL" ;

BO_ 3221225472 VECTOR__INDEPENDENT_SIG_MSG: 0 Vector__XXX
 SG_ Sig_BE_UInt_2 : 0|7@0+ (1,0) [0|127] "" Vector__XXX
 SG_ BSC6_INT_STATE : 0|8@0+ (1,0) [0|255] "" Vector__XXX

BO_ 2147483651 Mixed_motorola_float_Tx_2: 8 IVI_M2M
 SG_ Sig_BE_Int_8_Tx : 39|8@0- (1,0) [-128|127] ""  VCU
 SG_ Sig_LE_UInt_9_Tx : 60|4@1+ (1,0) [0|15] ""  VCU
